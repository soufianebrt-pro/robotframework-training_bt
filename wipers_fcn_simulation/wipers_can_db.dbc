VERSION ""

NS_ :

	BA_EXdef_
	BA_EX_KEY_
	ENVVAR_KEY_

BS_:

BU_: BCM Tester

BO_ 291 BodyControlModule: 1 BCM
 SG_ WiperMode : 0|3@1+ (1,0) [0|4] "" Tester

VAL_ 291 WiperMode 0 "Off" 1 "Interval" 2 "Slow" 3 "Fast" 4 "Mist";
